AUTOSAR XML (schema 4-0-3)
package /DaVinci_Project
  module config Com
    ComConfig
      6 x ComSignal:
        Cnt_oHIL_Vx_oCAN00_5a9efcf4_Rx: ComSignalType=UINT16
        Fault_oHIL_Cmd_oCAN00_ff5f7c49_Tx: ComSignalType=UINT8
        Heartbeat_oHIL_Cmd_oCAN00_d526ad84_Tx: ComSignalType=UINT8
        Pcon_oHIL_Cmd_oCAN00_2ed4937a_Tx: ComSignalType=UINT16
        Throttle_oHIL_Cmd_oCAN00_e9bc52e8_Tx: ComSignalType=UINT16
        Vx_oHIL_Vx_oCAN00_8d662997_Rx: ComSignalType=SINT16
  module config Rte
    10 x RteBswModuleInstance:
      BswM
        BswM_MainFunctionTimingEvent0 (RteBswEventToTaskMapping): RteBswUsedOsEventRef=Rte_Ev_Cyclic2_OsTask_BSW_0_10ms, RteBswUsedOsAlarmRef=Os/Rte_Al_TE2_OsTask_BSW_0_10ms
      CanIf
      CanSM
        CanSM_MainFunctionTimingEvent0 (RteBswEventToTaskMapping)
      Com
        Com_MainFunctionRxTimingEvent0 (RteBswEventToTaskMapping)
        Com_MainFunctionTxTimingEvent0 (RteBswEventToTaskMapping)
      ComM
        ComM_MainFunction_0TimingEvent0 (RteBswEventToTaskMapping): RteBswUsedOsEventRef=Rte_Ev_Cyclic2_OsTask_BSW_0_20ms, RteBswUsedOsAlarmRef=Os/Rte_Al_TE2_OsTask_BSW_0_20ms
      Det
      EcuM
        EcuM_MainFunctionTimingEvent0 (RteBswEventToTaskMapping): RteBswUsedOsEventRef=Rte_Ev_Cyclic2_OsTask_BSW_0_10ms, RteBswUsedOsAlarmRef=Os/Rte_Al_TE2_OsTask_BSW_0_10ms
      Gpt
      Mcu
      PduR
    6 x RteSwComponentInstance:
      BswM_EcuSwComposition
        Timer_BswM_MainFunction (RteEventToTaskMapping): RteUsedOsEventRef=Rte_Ev_Cyclic2_OsTask_BSW_0_10ms, RteUsedOsAlarmRef=Os/Rte_Al_TE2_OsTask_BSW_0_10ms
      ComM_EcuSwComposition
        Timer_ComM_MainFunction_0 (RteEventToTaskMapping): RteUsedOsEventRef=Rte_Ev_Cyclic2_OsTask_BSW_0_20ms, RteUsedOsAlarmRef=Os/Rte_Al_TE2_OsTask_BSW_0_20ms
      Det_EcuSwComposition
      EcuM_EcuSwComposition
        Timer_EcuM_MainFunction (RteEventToTaskMapping): RteUsedOsEventRef=Rte_Ev_Cyclic2_OsTask_BSW_0_10ms, RteUsedOsAlarmRef=Os/Rte_Al_TE2_OsTask_BSW_0_10ms
      HIL_Controller_EcuSwComposition
        TMT_Run_HIL_PI_10ms (RteEventToTaskMapping): RteUsedOsAlarmRef=Os/Rte_Al_TE_HIL_Controller_Run_HIL_PI_10ms
      Os_OsCore0_swc_EcuSwComposition
    RteOsInteraction
      3 x RteUsedOsActivation, all with RteExpectedActivationOffset=0:
        Rte_Al_TE_HIL_Controller_Run_HIL_PI_10ms: RteActivationOsAlarmRef=Os/Rte_Al_TE_HIL_Controller_Run_HIL_PI_10ms, RteActivationOsTaskRef=OsTask_10ms
        Rte_Al_TE2_OsTask_BSW_0_10ms: RteActivationOsAlarmRef=Os/Rte_Al_TE2_OsTask_BSW_0_10ms, RteActivationOsTaskRef=OsTask_BSW
        Rte_Al_TE2_OsTask_BSW_0_20ms: RteActivationOsAlarmRef=Os/Rte_Al_TE2_OsTask_BSW_0_20ms, RteActivationOsTaskRef=OsTask_BSW
  module config NvM
  module config Os
    OsTask_10ms (OsTask): OsTaskActivation=1, OsTaskPriority=2, OsTaskSchedule=FULL
    Rte_Al_TE_HIL_Controller_Run_HIL_PI_10ms (OsAlarm): OsAlarmCounterRef=SystemTimer
      OsAlarmAction
        OsAlarmActivateTask: OsAlarmActivateTaskRef=OsTask_10ms
    OsTask_BSW (OsTask):
      OsTaskActivation = 1
      OsTaskPriority = 1
      OsTaskSchedule = FULL
      OsTaskEventRef = Rte_Ev_Cyclic2_OsTask_BSW_0_10ms
      OsTaskEventRef = Rte_Ev_Cyclic2_OsTask_BSW_0_20ms
    Rte_Al_TE2_OsTask_BSW_0_10ms (OsAlarm): OsAlarmCounterRef=SystemTimer
      OsAlarmAction
        OsAlarmSetEvent: OsAlarmSetEventRef=Rte_Ev_Cyclic2_OsTask_BSW_0_10ms, OsAlarmSetEventTaskRef=OsTask_BSW
    Rte_Al_TE2_OsTask_BSW_0_20ms (OsAlarm): OsAlarmCounterRef=SystemTimer
      OsAlarmAction
        OsAlarmSetEvent: OsAlarmSetEventRef=Rte_Ev_Cyclic2_OsTask_BSW_0_20ms, OsAlarmSetEventTaskRef=OsTask_BSW
    Rte_Ev_Cyclic2_OsTask_BSW_0_10ms (OsEvent)
    Rte_Ev_Cyclic2_OsTask_BSW_0_20ms (OsEvent)
  module config EcuC
  ecuc value collection DaVinci_Project: ecuc-values=[Com, Rte, Os, EcuC, NvM]
