AUTOSAR XML (schema 4-2-1)
package /COM/VECTOR/CFG/WORKFLOW/SYSDESC/SYNC
  flat map FLATMAP
    9 x flat instance descriptor:
      If_HIL_Vx: upstream-reference=EcuSwComposition.If_HIL_Vx, ecu-extract-reference=COMPOSITIONTYPE.If_HIL_Vx
      If_HIL_Cmd: upstream-reference=EcuSwComposition.If_HIL_Cmd, ecu-extract-reference=COMPOSITIONTYPE.If_HIL_Cmd
      HIL_Controller: upstream-reference=EcuSwComposition.HIL_Controller, ecu-extract-reference=COMPOSITIONTYPE.HIL_Controller
      Vx: upstream-reference=EcuSwComposition.If_HIL_Vx.Vx, ecu-extract-reference=COMPOSITIONTYPE.If_HIL_Vx.Vx
      Cnt: upstream-reference=EcuSwComposition.If_HIL_Vx.Cnt, ecu-extract-reference=COMPOSITIONTYPE.If_HIL_Vx.Cnt
      Heartbeat: upstream-reference=EcuSwComposition.If_HIL_Cmd.Heartbeat, ecu-extract-reference=COMPOSITIONTYPE.If_HIL_Cmd.Heartbeat
      Throttle: upstream-reference=EcuSwComposition.If_HIL_Cmd.Throttle, ecu-extract-reference=COMPOSITIONTYPE.If_HIL_Cmd.Throttle
      Pcon: upstream-reference=EcuSwComposition.If_HIL_Cmd.Pcon, ecu-extract-reference=COMPOSITIONTYPE.If_HIL_Cmd.Pcon
      Fault: upstream-reference=EcuSwComposition.If_HIL_Cmd.Fault, ecu-extract-reference=COMPOSITIONTYPE.If_HIL_Cmd.Fault
