AUTOSAR XML (schema 4-2-1)
package /ActiveEcuC
  ecuc value collection ActiveEcuC: ecu-extract=SYSTEM, ecuc-values=[vSet, Base, Resource, Port, Os, Rte, CanIf, PduR, Com, EcuM, Det, BswM, EcuC, Gpt, Mcu, CanSM, Can, ComM]
