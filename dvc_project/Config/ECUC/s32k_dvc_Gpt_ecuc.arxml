AUTOSAR XML (schema 4-2-1)
package /ActiveEcuC
  module config Gpt: implementation-config-variant=VARIANT-PRE-COMPILE, module-description=Gpt_Impl
    GptChannelConfigSet
      GptChannelConfiguration:
        GptChannelId = 0
        GptHwChannel = LPIT_0_CH_0
        GptChannelMode = GPT_CH_MODE_CONTINUOUS
        GptChannelTickFrequency = 48000000
        GptLPitIsExternalTrigger = false
        GptLPitEnReloadOnTrigger = false
        GptLPitEnStopOnInterrupt = false
        GptLPitEnStartOnTrigger = false
        GptChannelTickValueMax = 4294967295
        GptFreezeEnable = true
        GptEnableWakeup = false
        GptChannelClkSrcRef = GptClockReferencePoint
    22 x GptHwConfiguration:
      GptHwConfiguration: GptIsrHwId=LPIT_0_CH_0, GptIsrEnable=true, GptModuleIsUsed=true
      GptHwConfiguration_1: GptIsrHwId=LPIT_0_CH_2, GptIsrEnable=false, GptModuleIsUsed=false
      GptHwConfiguration_2: GptIsrHwId=LPIT_0_CH_3, GptIsrEnable=false, GptModuleIsUsed=false
      GptHwConfiguration_3: GptIsrHwId=FTM_0_CH_0_CH_1, GptIsrEnable=false, GptModuleIsUsed=false
      GptHwConfiguration_4: GptIsrHwId=FTM_0_CH_2_CH_3, GptIsrEnable=false, GptModuleIsUsed=false
      GptHwConfiguration_5: GptIsrHwId=FTM_0_CH_4_CH_5, GptIsrEnable=false, GptModuleIsUsed=false
      GptHwConfiguration_6: GptIsrHwId=FTM_0_CH_6_CH_7, GptIsrEnable=false, GptModuleIsUsed=false
      GptHwConfiguration_7: GptIsrHwId=FTM_1_CH_0_CH_1, GptIsrEnable=false, GptModuleIsUsed=false
      GptHwConfiguration_8: GptIsrHwId=FTM_1_CH_2_CH_3, GptIsrEnable=false, GptModuleIsUsed=false
      GptHwConfiguration_9: GptIsrHwId=FTM_1_CH_4_CH_5, GptIsrEnable=false, GptModuleIsUsed=false
      GptHwConfiguration_10: GptIsrHwId=FTM_1_CH_6_CH_7, GptIsrEnable=false, GptModuleIsUsed=false
      GptHwConfiguration_11: GptIsrHwId=FTM_2_CH_0_CH_1, GptIsrEnable=false, GptModuleIsUsed=false
      GptHwConfiguration_12: GptIsrHwId=FTM_2_CH_2_CH_3, GptIsrEnable=false, GptModuleIsUsed=false
      GptHwConfiguration_13: GptIsrHwId=FTM_2_CH_4_CH_5, GptIsrEnable=false, GptModuleIsUsed=false
      GptHwConfiguration_14: GptIsrHwId=FTM_2_CH_6_CH_7, GptIsrEnable=false, GptModuleIsUsed=false
      GptHwConfiguration_15: GptIsrHwId=FTM_3_CH_0_CH_1, GptIsrEnable=false, GptModuleIsUsed=false
      GptHwConfiguration_16: GptIsrHwId=FTM_3_CH_2_CH_3, GptIsrEnable=false, GptModuleIsUsed=false
      GptHwConfiguration_17: GptIsrHwId=FTM_3_CH_4_CH_5, GptIsrEnable=false, GptModuleIsUsed=false
      GptHwConfiguration_18: GptIsrHwId=FTM_3_CH_6_CH_7, GptIsrEnable=false, GptModuleIsUsed=false
      GptHwConfiguration_19: GptIsrHwId=LPTMR_0_CH_0, GptIsrEnable=false, GptModuleIsUsed=false
      GptHwConfiguration_20: GptIsrHwId=SRTC_0_CH_0, GptIsrEnable=false, GptModuleIsUsed=false
      GptHwConfiguration_21: GptIsrHwId=LPIT_0_CH_1, GptIsrEnable=false, GptModuleIsUsed=false
    GptConfigurationOfOptApiServices:
      GptDeinitApi = true
      GptEnableDisableNotificationApi = true
      GptTimeElapsedApi = true
      GptTimeRemainingApi = true
      GptVersionInfoApi = true
      GptWakeupFunctionalityApi = true
      GptPredefTimerFunctionalityApi = false
    GptNonAUTOSAR: GptEnableUserModeSupport=false, GptEnableDualClockMode=false, GptChangeNextTimeoutValueApi=false, GptEnableTriggers=false
    GptDriverConfiguration:
      GptDevErrorDetect = true
      GptPredefTimer100us32bitEnable = false
      GptPredefTimer1usEnablingGrade = GPT_PREDEF_TIMER_1US_DISABLED
      GptReportWakeupSource = true
      GptRegisterLockingMode = NO_REGISTER_LOCKING
      GptClockReferencePoint: GptClockReference=McuClockReferencePoint_LPIT
    GptPredefTimerConfiguration
    CommonPublishedInformation:
      ArReleaseMajorVersion = 4
      ArReleaseMinorVersion = 2
      ArReleaseRevisionVersion = 2
      ModuleId = 100
      SwMajorVersion = 1
      SwMinorVersion = 0
      SwPatchVersion = 1
      VendorId = 43
