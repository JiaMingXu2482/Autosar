AUTOSAR XML (schema 4-2-1)
package /Port
  module config Port: implementation-config-variant=VARIANT-POST-BUILD
    CommonPublishedInformation:
      ArReleaseMajorVersion = 4
      ArReleaseMinorVersion = 2
      ArReleaseRevisionVersion = 2
      ModuleId = 124
      SwMajorVersion = 1
      SwMinorVersion = 0
      SwPatchVersion = 1
      VendorId = 43
    PortConfigSet
      NotUsedPortPin: PortPinDSE=Low_Drive_Strength, PortPinDirection=PORT_PIN_IN, PortPinLevelValue=PORT_PIN_LEVEL_LOW, PortPinPE=PullDisabled, PortPinPS=PullDown
      PortContainer_0 (PortContainer): PortNumberOfPortPins=2
        PortPin_1 (PortPin):
          PortPinDSE = Low_drive_strength
          PortPinDirection = PORT_PIN_IN
          PortPinDirectionChangeable = true
          PortPinId = 2
          PortPinInitialMode = PORT_GPIO_MODE
          PortPinLevelValue = PORT_PIN_LEVEL_LOW
          PortPinMode = CAN1_RX
          PortPinModeChangeable = true
          PortPinPE = PullDisabled
          PortPinPFE = false
          PortPinPS = PullDown
          PortPinPcr = 12
        PortPin_CAN1_TX (PortPin):
          PortPinDSE = Low_drive_strength
          PortPinDirection = PORT_PIN_OUT
          PortPinDirectionChangeable = true
          PortPinId = 1
          PortPinInitialMode = PORT_GPIO_MODE
          PortPinLevelValue = PORT_PIN_LEVEL_LOW
          PortPinMode = CAN1_TX
          PortPinModeChangeable = true
          PortPinPE = PullDisabled
          PortPinPFE = false
          PortPinPS = PullDown
          PortPinPcr = 13
    PortGeneral:
      PortDevErrorDetect = true
      PortEnableUserModeSupport = false
      PortSet2PinsDirectionApi = false
      PortSetPinDirectionApi = true
      PortSetPinModeApi = true
      PortSetPinModeDoesNotTouchGpioLevel = false
      PortVersionInfoApi = true
