AUTOSAR XML (schema 4-2-1)
package /ActiveEcuC
  module config ComM: implementation-config-variant=VARIANT-PRE-COMPILE, module-description=ComM_Impl
    ComMGeneral:
      ComMPncIdCounting = COMM_PNC_ID_COUNT_FROM_NM_MESSAGE
      ComMPncSupport = false
      ComMDevErrorDetect = true
      ComMEcuGroupClassification = 3
      ComMModeLimitationEnabled = false
      ComMSynchronousWakeUp = true
      ComMTMinFullComModeDuration = 5
      ComMVersionInfoApi = false
      ComMWakeupInhibitionEnabled = false
      ComMSafeBswChecks = false
      ComMGeneration: ComMOutOfBoundsWriteSanitizer=false, ComMOutOfBoundsReadSanitizer=false
    ComMConfigSet: ComMPncEnabled=false
      CN_CAN00_0446c7f3 (ComMChannel):
        ComMBusType = COMM_BUS_TYPE_CAN
        ComMChannelId = 0
        ComMFullCommRequestNotificationEnabled = false
        ComMMainFunctionPeriod = 0.02
        ComMNoCom = false
        ComMNoWakeup = false
        ComMNetworkManagement: ComMNmVariant=NONE, ComMPncNmRequest=false
        CN_CAN00_bdd983bf (ComMUserPerChannel): ComMUserChannel=CN_CAN00_eab0f638
      CN_CAN00_eab0f638 (ComMUser): ComMUserIdentifier=0, ComMUserModeNotification=false
