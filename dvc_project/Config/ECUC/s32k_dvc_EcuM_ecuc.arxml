AUTOSAR XML (schema 4-2-1)
package /ActiveEcuC
  module config EcuM: implementation-config-variant=VARIANT-PRE-COMPILE, module-description=EcuM_Impl
    EcuMFlexGeneral: EcuMAlarmClockPresent=false, EcuMResetLoopDetection=false, EcuMEnableDefBehaviour=false
    EcuMGeneral:
      EcuMDevErrorDetect = true
      EcuMIncludeDem = true
      EcuMIncludeDet = true
      EcuMMainFunctionPeriod = 0.01
      EcuMVersionInfoApi = false
      EcuMDeferredBswMNotification = false
      EcuMSlaveCoreHandling = true
      EcuMEnableFixBehavior = false
      EcuMNonChannelWakeupInRun = false
      EcuMGeneration: EcuMOutOfBoundsWriteSanitizer=false, EcuMOutOfBoundsReadSanitizer=false, EcuMInterfacesForDeactivatedData=false
    EcuMConfiguration
      EcuMCommonConfiguration: EcuMConfigConsistencyHash=10835611140094731299, EcuMDefaultAppMode=OSDEFAULTAPPMODE, EcuMOSResource=EcuM_Resource
        5 x EcuMWakeupSource, all with EcuMValidationTimeout=0, EcuMCheckWakeupTimeout=0, EcuMWakeupSourcePolling=false:
          ECUM_WKSOURCE_POWER: EcuMWakeupSourceId=0
          ECUM_WKSOURCE_RESET: EcuMWakeupSourceId=1
          ECUM_WKSOURCE_INTERNAL_RESET: EcuMWakeupSourceId=2
          ECUM_WKSOURCE_INTERNAL_WDG: EcuMWakeupSourceId=3
          ECUM_WKSOURCE_EXTERNAL_WDG: EcuMWakeupSourceId=4
        EcuMDefaultShutdownTarget: EcuMDefaultState=EcuMStateOff
        EcuMDriverInitListOne
        CN_CAN00_0446c7f3 (EcuMWakeupSource): EcuMWakeupSourceId=5, EcuMWakeupSourcePolling=false, EcuMComMChannelRef=CN_CAN00_0446c7f3
        EcuMDriverRestartList
      EcuMFlexConfiguration: EcuMFlexModuleConfigurationRef=CanConfigSet, EcuMNormalMcuModeRef=McuModeSettingConf, EcuMGptChannelRef=GptChannelConfiguration
        3 x EcuMResetMode:
          ECUM_RESET_MCU: EcuMResetModeId=0
          ECUM_RESET_WDG: EcuMResetModeId=1
          ECUM_RESET_IO: EcuMResetModeId=2
        4 x EcuMShutdownCause:
          ECUM_CAUSE_UNKNOWN: EcuMShutdownCauseId=0
          ECUM_CAUSE_ECU_STATE: EcuMShutdownCauseId=1
          ECUM_CAUSE_WDGM: EcuMShutdownCauseId=2
          ECUM_CAUSE_DCM: EcuMShutdownCauseId=3
        ECUM_RESET_WAKEUP (EcuMResetMode): EcuMResetModeId=3
        EcuMShutdownTarget: EcuMShutdownTargetId=0
