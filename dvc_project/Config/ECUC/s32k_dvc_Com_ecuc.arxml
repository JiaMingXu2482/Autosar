AUTOSAR XML (schema 4-2-1)
package /ActiveEcuC
  module config Com: implementation-config-variant=VARIANT-PRE-COMPILE, module-description=Com_Impl
    ComConfig: ComConfigurationId=0, ComRxDeferredNotificationCacheSize=0, ComRxImmediateNotificationCacheSize=0
      ComTimeBase: ComRxTimeBase=0.01, ComTxTimeBase=0.01, ComGwTimeBase=0.01
      Throttle_oHIL_Cmd_oCAN00_e9bc52e8_Tx (ComSignal):
        ComBitPosition = 0
        ComBitSize = 16
        ComSignalEndianness = LITTLE_ENDIAN
        ComSignalType = UINT16
        ComTransferProperty = PENDING
        ComSignalInitValue = 0
        ComSignalAccess = ACCESS_NEEDED_BY_SWC_OR_COM
        ComHandleId = 3
        ComSystemTemplateSystemSignalRef = Throttle
      HIL_Cmd_oCAN00_e2b6e504_Tx (ComIPdu):
        ComIPduDirection = SEND
        ComIPduType = NORMAL
        ComIPduHandleId = 0
        ComIPduSignalProcessing = DEFERRED
        ComIPduCancellationSupport = false
        ComIPduGroupRef = S32K144_oCAN00_Tx_735ad804
        ComIPduSignalRef = Fault_oHIL_Cmd_oCAN00_ff5f7c49_Tx
        ComIPduSignalRef = Heartbeat_oHIL_Cmd_oCAN00_d526ad84_Tx
        ComIPduSignalRef = Pcon_oHIL_Cmd_oCAN00_2ed4937a_Tx
        ComIPduSignalRef = Throttle_oHIL_Cmd_oCAN00_e9bc52e8_Tx
        ComPduIdRef = HIL_Cmd_oCAN00_e2b6e504_Tx
        ComTxIPdu: ComTxIPduUnusedAreasDefault=0, ComMinimumDelayTime=0
          ComTxModeTrue
            ComTxMode: ComTxModeMode=NONE
          ComTxModeFalse
            ComTxMode: ComTxModeMode=NONE
      Heartbeat_oHIL_Cmd_oCAN00_d526ad84_Tx (ComSignal):
        ComBitPosition = 32
        ComBitSize = 8
        ComSignalEndianness = LITTLE_ENDIAN
        ComSignalType = UINT8
        ComTransferProperty = PENDING
        ComSignalInitValue = 0
        ComSignalAccess = ACCESS_NEEDED_BY_SWC_OR_COM
        ComHandleId = 1
        ComSystemTemplateSystemSignalRef = Heartbeat
      Vx_oHIL_Vx_oCAN00_8d662997_Rx (ComSignal):
        ComBitPosition = 0
        ComBitSize = 16
        ComSignalEndianness = LITTLE_ENDIAN
        ComSignalType = SINT16
        ComSignalInitValue = 0
        ComSignalAccess = ACCESS_NEEDED_BY_SWC_OR_COM
        ComHandleId = 1
        ComSystemTemplateSystemSignalRef = Vx
      S32K144_oCAN00_Tx_735ad804 (ComIPduGroup): ComIPduGroupHandleId=1
      HIL_Vx_oCAN00_693fb760_Rx (ComIPdu):
        ComIPduDirection = RECEIVE
        ComIPduType = NORMAL
        ComIPduHandleId = 0
        ComIPduSignalProcessing = DEFERRED
        ComIPduCancellationSupport = false
        ComIPduGroupRef = S32K144_oCAN00_Rx_25007f82
        ComIPduSignalRef = Cnt_oHIL_Vx_oCAN00_5a9efcf4_Rx
        ComIPduSignalRef = Vx_oHIL_Vx_oCAN00_8d662997_Rx
        ComPduIdRef = HIL_Vx_oCAN00_693fb760_Rx
      S32K144_oCAN00_Rx_25007f82 (ComIPduGroup): ComIPduGroupHandleId=0
      3 x ComSignal, all with ComSignalEndianness=LITTLE_ENDIAN, ComSignalInitValue=0, ComSignalAccess=ACCESS_NEEDED_BY_SWC_OR_COM:
        Cnt_oHIL_Vx_oCAN00_5a9efcf4_Rx: ComBitPosition=16, ComBitSize=16, ComSignalType=UINT16, ComHandleId=0, ComSystemTemplateSystemSignalRef=Cnt
        Pcon_oHIL_Cmd_oCAN00_2ed4937a_Tx: ComBitPosition=16, ComBitSize=16, ComSignalType=UINT16, ComTransferProperty=PENDING, ComHandleId=2, ComSystemTemplateSystemSignalRef=Pcon
        Fault_oHIL_Cmd_oCAN00_ff5f7c49_Tx: ComBitPosition=40, ComBitSize=8, ComSignalType=UINT8, ComTransferProperty=PENDING, ComHandleId=0, ComSystemTemplateSystemSignalRef=Fault
    ComGeneral:
      ComConfigurationUseDet = true
      ComEnableSignalGroupArrayApi = false
      ComRetryFailedTransmitRequests = false
      ComSupportedIPduGroups = 2
      ComVersionInfoApi = false
      ComAdvancedIPduCallouts = true
      ComOptimizedIPduGroupHandling = false
      ComMetaDataSupport = false
      ComReceiveSignalMacroAPI = false
      ComDeferredEventCacheSupport = false
      ComMainfunctionTimingDomainSupport = false
      ComDescriptionRoutingCodeGeneration = false
      ComSafeBswChecks = false
    ComGeneration:
      ComOutOfBoundsWriteProtectionStrategy = NONE
      ComOutOfBoundsWriteSanitizer = false
      ComOutOfBoundsReadSanitizer = false
      ComReduceConstantData2Define = false
      ComBoolDataInArrayOfStructStrategy = BOOLEAN
      ComDeduplicateIndirectedData = true
      ComDataDeduplicationStrategy = WITH_CAST
      ComReduceBoolDataByNegationThreshold = 2
      ComReduceBoolDataByNumericalComparisonThreshold = 2
      ComReduceBoolDataByNumericalRelationThreshold = 2
      ComReduceBoolDataByNumericalOperandStrategy = WITH_ANY_VALUE
      ComReduceNumericalDataByOffsetThreshold = 2
      ComReduceNumericalDataByArraySubtractionThreshold = 2
      ComReduceDataByStreaming = false
      ComShortSymbols = false
      ComInterfacesForDeactivatedData = false
      ComReferringKeysInComments = false
    ComOptimization:
      ComTxCyclicProcessingISRLockThreshold = 1
      ComTxDeadlineMonitoringISRLockThreshold = 1
      ComTxProcessingISRLockThreshold = 1
      ComRxDeadlineMonitoringISRLockThreshold = 1
      ComRxDeferredProcessingISRLockThreshold = 1
      ComGatewayProcessingISRLockThreshold = 1
      ComGatewayDescriptionProcessingISRLockThreshold = 1
      ComIPduGroupISRLockThreshold = 1
