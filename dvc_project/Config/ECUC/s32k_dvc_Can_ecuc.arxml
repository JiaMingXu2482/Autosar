AUTOSAR XML (schema 4-2-1)
package /ActiveEcuC
  module config Can: implementation-config-variant=VARIANT-PRE-COMPILE
    CommonPublishedInformation:
      ArReleaseMajorVersion = 4
      ArReleaseMinorVersion = 2
      ArReleaseRevisionVersion = 2
      ModuleId = 80
      SwMajorVersion = 1
      SwMinorVersion = 0
      SwPatchVersion = 1
      VendorApiInfix = 
      VendorId = 43
    CanGeneral:
      CanIndex = 0
      CanChangeBaudrateApi = true
      CanDevErrorDetection = true
      CanEnableUserModeSupport = false
      CanVersionInfoApi = true
      CanMainFunctionModePeriod = 0.001
      CanMultiplexedTransmission = true
      CanMaxMessageBuffers = 32
      CanTimeoutDuration = 0.1
      CanAllowLoopAsCycle = false
      CanNumberOfTimeOutLoop = 1
      CanCodeSizeOptimization = false
      CanExtendedIDSupport = true
      CanMBCountExtensionSupport = true
      CanApiEnableMbAbort = false
      CanAbortOnlyOneMB = true
      CanEnableDualClockMode = false
      CanSpecifiedRAMBlockSize = false
      MBDSR = CAN_8_BYTES_PAYLOAD
      CanPublicIcomSupport = false
      CanSupportTTCANRef = CanIfPrivateCfg
    CanConfigSet
      CN_CAN00_0446c7f3_Tx (CanHardwareObject): CanHandleType=BASIC, CanObjectType=TRANSMIT, CanIdType=STANDARD, CanMBPrio=0, CanObjectId=0, CanHwObjectCount=1, CanControllerRef=CT_CAN00_c7e80473
      CN_CAN00_9b56bd8f_Rx (CanHardwareObject): CanHandleType=BASIC, CanIdType=STANDARD, CanObjectType=RECEIVE, CanMBPrio=0, CanObjectId=1, CanHwObjectCount=1, CanControllerRef=CT_CAN00_c7e80473
      CT_CAN00_c7e80473 (CanController):
        CanControllerActivation = true
        CanHwChannel = FlexCAN_A
        CanControllerBaseAddress = 0
        CanControllerIcomSupported = false
        CanControllerId = 1
        CanRxProcessing = INTERRUPT
        CanTxProcessing = POLLING
        CanBusoffProcessing = POLLING
        CanWakeupFunctionalityAPI = false
        CanWakeupProcessing = POLLING
        CanBccSupport = false
        CanWakeupSupport = false
        CanListenOnlyMode = false
        CanLoopBackMode = false
        CanSoftwareBusOffRecovery = false
        CanAutoBusOffRecovery = false
        CanTrippleSamplingEnable = false
        CanWakeUpSourceFilter = false
        CanLowestBuffTransmitFirst = true
        CanLocalPriorityEn = false
        CanClockFromBus = true
        CanControllerRxFifoEnable = false
        CanRxFifoWarningNotification = NULL_PTR
        CanRxFifoOverflowNotification = NULL_PTR
        CanErrorControllerNotifEn = true
        CanErrorControllerNotification = NULL_PTR
        CanControllerDefaultBaudrate = CanControllerBaudrateConfig
        CanWakeupSourceRef = CN_CAN00_0446c7f3
        CanCpuClockRef = McuClockReferencePoint
        CanRxFifo: CanControllerIDAcceptanceMode=A, CanRxFifoFiltersNumber=FILTERS_NUMBER_8, CanRxFifoGlobalMaskValue=2047
        CanControllerBaudrateConfig:
          CanControllerCheckCanStandard = true
          CanAdvancedSetting = false
          CanBusLength = 40
          CanPropDelayTranceiver = 150
          CanTxArbitrationStartDelay = 12
          CanControllerPrescaller = 6
          CanControllerBaudRateConfigID = 0
          CanControllerPrescaller_Alt = 6
          CanControllerBaudRate = 500
          CanControllerSyncSeg = 1
          CanControllerPropSeg = 5
          CanControllerSeg1 = 5
          CanControllerSeg2 = 5
          CanControllerSyncJumpWidth = 1
          CanControllerCBT:
            CanControllerCbtEnable = false
            CanControllerCbtPrescaller = 100
            CanControllerCbtBaudRate = 0
            CanControllerCbtSyncSeg = 1
            CanControllerCbtPropSeg = 1
            CanControllerCbtSeg1 = 1
            CanControllerCbtSeg2 = 1
            CanControllerSyncJumpWidthCbt = 1
