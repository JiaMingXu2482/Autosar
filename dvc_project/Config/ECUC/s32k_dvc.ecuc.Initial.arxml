AUTOSAR XML (schema 4-2-1)
package /InitialEcuC
  ecuc value collection InitialEcuC: ecuc-values=[Can, CanIf, CanSM, Com, ComM, EcuC, EcuM, PduR]
  module config Can
    CanConfigSet
      CT_CAN00_c7e80473 (CanController):
        CanControllerActivation = true
        CanControllerDefaultBaudrate = CanControllerBaudrateConfig
        CanWakeupSourceRef = EcuMCommonConfiguration/CN_CAN00_0446c7f3
        CanControllerBaudrateConfig
      CN_CAN00_0446c7f3_Tx (CanHardwareObject): CanHandleType=BASIC, CanObjectType=TRANSMIT, CanControllerRef=CanConfigSet/CT_CAN00_c7e80473
      CN_CAN00_9b56bd8f_Rx (CanHardwareObject): CanHandleType=BASIC, CanIdType=STANDARD, CanObjectType=RECEIVE, CanControllerRef=CanConfigSet/CT_CAN00_c7e80473
    CanGeneral: CanIndex=0
  module config CanIf
    CanIfCtrlDrvCfg_7d254554 (CanIfCtrlDrvCfg): CanIfCtrlDrvInitHohConfigRef=CanIfInitHohCfg, CanIfCtrlDrvNameRef=CanGeneral
      CT_CAN00_c7e80473 (CanIfCtrlCfg): CanIfCtrlCanCtrlRef=CanConfigSet/CT_CAN00_c7e80473
    CanIfInitCfg
      CHNL_0fb271d2 (CanIfBufferCfg): CanIfBufferSize=0, CanIfBufferHthRef=CanIfInitHohCfg/CN_CAN00_0446c7f3_Tx
      CanIfInitHohCfg: CanIfInitRefCfgSet=CanConfigSet
        CN_CAN00_9b56bd8f_Rx (CanIfHrhCfg): CanIfHrhCanCtrlIdRef=CanIfCtrlDrvCfg_7d254554/CT_CAN00_c7e80473, CanIfHrhIdSymRef=CanConfigSet/CN_CAN00_9b56bd8f_Rx
        CN_CAN00_0446c7f3_Tx (CanIfHthCfg): CanIfHthCanCtrlIdRef=CanIfCtrlDrvCfg_7d254554/CT_CAN00_c7e80473, CanIfHthIdSymRef=CanConfigSet/CN_CAN00_0446c7f3_Tx
      HIL_Vx_oCAN00_56e98cb6_Rx (CanIfRxPduCfg):
        CanIfRxPduCanId = 256
        CanIfRxPduCanIdType = STANDARD_CAN
        CanIfRxPduDlc = 8
        CanIfRxPduUserRxIndicationName = PduR_CanIfRxIndication
        CanIfRxPduUserRxIndicationUL = PDUR
        CanIfRxPduHrhIdRef = CanIfInitHohCfg/CN_CAN00_9b56bd8f_Rx
        CanIfRxPduRef = EcucPduCollection/HIL_Vx_oCAN00_b4ab2fe5_Rx
      HIL_Cmd_oCAN00_4100b9ad_Tx (CanIfTxPduCfg):
        CanIfTxPduCanId = 512
        CanIfTxPduCanIdType = STANDARD_CAN
        CanIfTxPduDlc = 8
        CanIfTxPduUserTxConfirmationName = PduR_CanIfTxConfirmation
        CanIfTxPduUserTxConfirmationUL = PDUR
        CanIfTxPduBufferRef = CanIfInitCfg/CHNL_0fb271d2
        CanIfTxPduRef = EcucPduCollection/HIL_Cmd_oCAN00_8c26e444_Tx
    CanIfPrivateCfg: CanIfPrivateSoftwareFilterType=LINEAR
    CanIfPublicCfg: CanIfPublicPnSupport=false
  module config CanSM
    CanSMConfiguration
      CHNL_0fb271d2 (CanSMManagerNetwork): CanSMComMNetworkHandleRef=ComMConfigSet/CN_CAN00_0446c7f3
        CT_CAN00_636411b8 (CanSMController): CanSMControllerId=CanIfCtrlDrvCfg_7d254554/CT_CAN00_c7e80473
  module config Com
    ComConfig
      HIL_Cmd_oCAN00_e2b6e504_Tx (ComIPdu):
        ComIPduDirection = SEND
        ComIPduType = NORMAL
        ComIPduGroupRef = S32K144_oCAN00_Tx_735ad804
        ComIPduSignalRef = Fault_oHIL_Cmd_oCAN00_ff5f7c49_Tx
        ComIPduSignalRef = Heartbeat_oHIL_Cmd_oCAN00_d526ad84_Tx
        ComIPduSignalRef = Pcon_oHIL_Cmd_oCAN00_2ed4937a_Tx
        ComIPduSignalRef = Throttle_oHIL_Cmd_oCAN00_e9bc52e8_Tx
        ComPduIdRef = EcucPduCollection/HIL_Cmd_oCAN00_e2b6e504_Tx
        ComTxIPdu: ComTxIPduUnusedAreasDefault=0
      HIL_Vx_oCAN00_693fb760_Rx (ComIPdu):
        ComIPduDirection = RECEIVE
        ComIPduType = NORMAL
        ComIPduGroupRef = S32K144_oCAN00_Rx_25007f82
        ComIPduSignalRef = Cnt_oHIL_Vx_oCAN00_5a9efcf4_Rx
        ComIPduSignalRef = Vx_oHIL_Vx_oCAN00_8d662997_Rx
        ComPduIdRef = EcucPduCollection/HIL_Vx_oCAN00_693fb760_Rx
      S32K144_oCAN00_Rx_25007f82 (ComIPduGroup)
      S32K144_oCAN00_Tx_735ad804 (ComIPduGroup)
      6 x ComSignal, all with ComSignalEndianness=LITTLE_ENDIAN:
        Cnt_oHIL_Vx_oCAN00_5a9efcf4_Rx: ComBitPosition=16, ComBitSize=16, ComSignalType=UINT16, ComSystemTemplateSystemSignalRef=Cnt
        Fault_oHIL_Cmd_oCAN00_ff5f7c49_Tx: ComBitPosition=40, ComBitSize=8, ComSignalType=UINT8, ComTransferProperty=PENDING, ComSystemTemplateSystemSignalRef=Fault
        Heartbeat_oHIL_Cmd_oCAN00_d526ad84_Tx: ComBitPosition=32, ComBitSize=8, ComSignalType=UINT8, ComTransferProperty=PENDING, ComSystemTemplateSystemSignalRef=Heartbeat
        Pcon_oHIL_Cmd_oCAN00_2ed4937a_Tx: ComBitPosition=16, ComBitSize=16, ComSignalType=UINT16, ComTransferProperty=PENDING, ComSystemTemplateSystemSignalRef=Pcon
        Throttle_oHIL_Cmd_oCAN00_e9bc52e8_Tx: ComBitPosition=0, ComBitSize=16, ComSignalType=UINT16, ComTransferProperty=PENDING, ComSystemTemplateSystemSignalRef=Throttle
        Vx_oHIL_Vx_oCAN00_8d662997_Rx: ComBitPosition=0, ComBitSize=16, ComSignalType=SINT16, ComSystemTemplateSystemSignalRef=Vx
    ComGeneral
  module config ComM
    ComMConfigSet: ComMPncEnabled=false
      CN_CAN00_0446c7f3 (ComMChannel): ComMBusType=COMM_BUS_TYPE_CAN, ComMChannelId=0
        ComMNetworkManagement: ComMNmVariant=NONE
        CN_CAN00_bdd983bf (ComMUserPerChannel): ComMUserChannel=CN_CAN00_eab0f638
      CN_CAN00_eab0f638 (ComMUser): ComMUserIdentifier=0
    ComMGeneral: ComMPncIdCounting=COMM_PNC_ID_COUNT_FROM_NM_MESSAGE, ComMPncSupport=false
  module config EcuC
    EcucPduCollection: PduIdTypeEnum=UINT8, PduLengthTypeEnum=UINT8
      4 x Pdu, all with PduLength=8:
        HIL_Cmd_oCAN00_8c26e444_Tx: SysTPduToFrameMappingRef=HIL_Cmd
        HIL_Cmd_oCAN00_e2b6e504_Tx
        HIL_Vx_oCAN00_693fb760_Rx
        HIL_Vx_oCAN00_b4ab2fe5_Rx: SysTPduToFrameMappingRef=HIL_Vx
  module config EcuM
    EcuMConfiguration
      EcuMCommonConfiguration
        EcuMDriverInitListOne
        EcuMDriverRestartList
        CN_CAN00_0446c7f3 (EcuMWakeupSource): EcuMWakeupSourceId=5, EcuMComMChannelRef=ComMConfigSet/CN_CAN00_0446c7f3
      EcuMFlexConfiguration: EcuMFlexModuleConfigurationRef=CanConfigSet
  module config PduR
    PduRGeneral
    PduRRoutingTables
      PduRRoutingTable
        HIL_Cmd_oCAN00_e2b6e504_Tx (PduRRoutingPath)
          HIL_Cmd_oCAN00_8c26e444_Tx (PduRDestPdu): PduRDestPduRef=EcucPduCollection/HIL_Cmd_oCAN00_8c26e444_Tx
          PduRSrcPdu_9f25b6b3 (PduRSrcPdu): PduRSrcPduRef=EcucPduCollection/HIL_Cmd_oCAN00_e2b6e504_Tx
        HIL_Vx_oCAN00_b4ab2fe5_Rx (PduRRoutingPath)
          HIL_Vx_oCAN00_b4ab2fe5_Rx_27d3daed_Rx (PduRDestPdu): PduRDestPduRef=EcucPduCollection/HIL_Vx_oCAN00_693fb760_Rx
          PduRSrcPdu_27d3daed (PduRSrcPdu): PduRSrcPduRef=EcucPduCollection/HIL_Vx_oCAN00_b4ab2fe5_Rx
